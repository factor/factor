## misc/riscv32/buildroot_defconfig
```kconfig
# Buildroot 2026.08: QEMU virt, RV32GC, ILP32D, little endian, with MMU.
BR2_riscv=y
BR2_riscv_g=y
BR2_RISCV_ISA_RVC=y
BR2_RISCV_32=y
BR2_RISCV_USE_MMU=y
BR2_RISCV_ABI_ILP32D=y
BR2_JLEVEL=4
BR2_TOOLCHAIN_BUILDROOT_GLIBC=y
BR2_TOOLCHAIN_BUILDROOT_CXX=y
BR2_PACKAGE_HOST_LINUX_HEADERS_CUSTOM_6_18=y
BR2_GLOBAL_PATCH_DIR="board/qemu/patches"
BR2_DOWNLOAD_FORCE_CHECK_HASHES=y
BR2_TARGET_GENERIC_HOSTNAME="factor-riscv32"
BR2_TARGET_GENERIC_ISSUE="Factor RV32 Linux development environment"
BR2_TARGET_GENERIC_GETTY_PORT="ttyS0"
BR2_SYSTEM_DHCP="eth0"
BR2_GENERATE_LOCALE="en_US.UTF-8"
BR2_LINUX_KERNEL=y
BR2_LINUX_KERNEL_CUSTOM_VERSION=y
BR2_LINUX_KERNEL_CUSTOM_VERSION_VALUE="6.18.7"
BR2_LINUX_KERNEL_DEFCONFIG="rv32"
BR2_TARGET_OPENSBI=y
BR2_TARGET_OPENSBI_CUSTOM_VERSION=y
BR2_TARGET_OPENSBI_CUSTOM_VERSION_VALUE="1.6"
BR2_TARGET_OPENSBI_PLAT="generic"
BR2_PACKAGE_BUSYBOX_SHOW_OTHERS=y
BR2_PACKAGE_BASH=y
BR2_PACKAGE_DROPBEAR=y
BR2_PACKAGE_DROPBEAR_CLIENT=y
BR2_PACKAGE_GDB=y
BR2_PACKAGE_GDB_DEBUGGER=y
BR2_PACKAGE_GIT=y
BR2_PACKAGE_LIBFFI=y
BR2_PACKAGE_OPENSSL=y
BR2_PACKAGE_LIBOPENSSL=y
BR2_PACKAGE_LIBOPENSSL_BIN=y
BR2_PACKAGE_CA_CERTIFICATES=y
BR2_PACKAGE_ZLIB=y
BR2_PACKAGE_ZSTD=y
BR2_PACKAGE_SNAPPY=y
BR2_PACKAGE_BZIP2=y
BR2_PACKAGE_FILE=y
BR2_PACKAGE_GDBM=y
BR2_PACKAGE_GMP=y
BR2_PACKAGE_GSL=y
BR2_PACKAGE_LIBCURL=y
BR2_PACKAGE_LIBCURL_CURL=y
BR2_PACKAGE_LIBUV=y
BR2_PACKAGE_LIBYAML=y
BR2_PACKAGE_PCRE2=y
BR2_PACKAGE_SQLITE=y
BR2_PACKAGE_ZEROMQ=y
# GTK3 is the bootstrap UI backend on RV32 Linux.
BR2_PACKAGE_XORG7=y
BR2_PACKAGE_XSERVER_XORG_SERVER=y
BR2_PACKAGE_XSERVER_XORG_SERVER_XVFB=y
BR2_PACKAGE_XAPP_XAUTH=y
BR2_PACKAGE_XAPP_XKBCOMP=y
BR2_PACKAGE_MESA3D=y
BR2_PACKAGE_MESA3D_GALLIUM_DRIVER_SOFTPIPE=y
BR2_PACKAGE_MESA3D_OPENGL_GLX=y
BR2_PACKAGE_MESA3D_OPENGL_EGL=y
BR2_PACKAGE_MESA3D_OPENGL_ES=y
BR2_PACKAGE_LIBGLU=y
BR2_PACKAGE_LIBGTK3=y
BR2_PACKAGE_LIBGTK3_X11=y
# BR2_PACKAGE_LIBGTK3_WAYLAND is not set
# BR2_PACKAGE_LIBGTK3_BROADWAY is not set
BR2_PACKAGE_PANGO=y
BR2_PACKAGE_CAIRO=y
BR2_PACKAGE_CAIRO_PNG=y
BR2_PACKAGE_CAIRO_ZLIB=y
BR2_PACKAGE_LIBEPOXY=y
BR2_PACKAGE_FONTCONFIG=y
BR2_PACKAGE_DEJAVU=y
BR2_PACKAGE_OPENAL=y
BR2_PACKAGE_SDL2=y
BR2_PACKAGE_LIBGLFW=y
BR2_PACKAGE_POSTGRESQL=y
BR2_PACKAGE_CLANG=y
# Buildroot names the image rootfs.ext2 even when its contents are ext4.
BR2_TARGET_ROOTFS_EXT2=y
BR2_TARGET_ROOTFS_EXT2_4=y
BR2_TARGET_ROOTFS_EXT2_SIZE="2048M"
```
